macro_switch_left: macro_switch_left {
    compatible = "zmk,behavior-macro";
    label = "macro_switch_left";
    #binding-cells = <0>;
    bindings
            = <&macro_press &kp LCTRL>
            , <&macro_press &kp LALT>
            , <&macro_tap &kp HOME>
            , <&macro_release &kp LALT>
            , <&macro_wait_time 500>
            , <&macro_press &kp LGUI>
            , <&macro_tap &kp LEFT>
            , <&macro_release &kp LEFT_WIN>
            , <&macro_release &kp LCTRL>
  ;
};
macro_switch_right: macro_switch_right {
    compatible = "zmk,behavior-macro";
    label = "macro_switch_right";
    #binding-cells = <0>;
    bindings
            = <&macro_press &kp LCTRL>
            , <&macro_press &kp LALT>
            , <&macro_tap &kp HOME>
            , <&macro_release &kp LALT>
            , <&macro_wait_time 500>
            , <&macro_press &kp LGUI>
            , <&macro_tap &kp RIGHT>
            , <&macro_release &kp LEFT_WIN>
            , <&macro_release &kp LCTRL>
  ;
};
